/* USER CODE BEGIN Header */
/**
  ******************************************************************************
  * @file           : main.c
  * @brief          : Main program body
  ******************************************************************************
  * @attention
  *
  * Copyright (c) 2025 STMicroelectronics.
  * All rights reserved.
  *
  * This software is licensed under terms that can be found in the LICENSE file
  * in the root directory of this software component.
  * If no LICENSE file comes with this software, it is provided AS-IS.
  *
  ******************************************************************************
  */
/* USER CODE END Header */
/* Includes ------------------------------------------------------------------*/
#include "main.h"
#include "dma.h"
#include "i2c.h"
#include "spi.h"
#include "tim.h"
#include "usart.h"
#include "gpio.h"

/* Private includes ----------------------------------------------------------*/
/* USER CODE BEGIN Includes */
#include "lcd_st7735.h"
#include "stdio.h"
#include "math.h"
#include "bmp.h"
/* USER CODE END Includes */

/* Private typedef -----------------------------------------------------------*/
/* USER CODE BEGIN PTD */
uint32_t sys_clk=0;
/* USER CODE END PTD */

/* Private define ------------------------------------------------------------*/
/* USER CODE BEGIN PD */
/* USER CODE END PD */

/* Private macro -------------------------------------------------------------*/
/* USER CODE BEGIN PM */

/* USER CODE END PM */

/* Private variables ---------------------------------------------------------*/

/* USER CODE BEGIN PV */
#include <string.h>

#define ADDR_24LCxx_Write 0xA0
#define ADDR_24LCxx_Read 0xA1
uint8_t writedat;
uint8_t readdat;
uint16_t HelloY=0;
uint16_t fre=1;
uint16_t num=0;
const	uint16_t sinwave[3600]=
	{128,128,128,129,129,129,129,130,130,130,130,130,131,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128
};
uint8_t gray[1600];
uint8_t edge[1600];
/* USER CODE END PV */

/* Private function prototypes -----------------------------------------------*/
void SystemClock_Config(void);
/* USER CODE BEGIN PFP */

/* USER CODE END PFP */

/* Private user code ---------------------------------------------------------*/
/* USER CODE BEGIN 0 */
/* USER CODE END 0 */

/**
  * @brief  The application entry point.
  * @retval int
  */
int main(void)
{

  /* USER CODE BEGIN 1 */

  /* USER CODE END 1 */

  /* MCU Configuration--------------------------------------------------------*/

  /* Reset of all peripherals, Initializes the Flash interface and the Systick. */
  HAL_Init();

  /* USER CODE BEGIN Init */

  /* USER CODE END Init */

  /* Configure the system clock */
  SystemClock_Config();

  /* USER CODE BEGIN SysInit */

  /* USER CODE END SysInit */

  /* Initialize all configured peripherals */
  MX_GPIO_Init();
  MX_DMA_Init();
  MX_USART1_UART_Init();
  MX_I2C1_Init();
  MX_SPI1_Init();
  MX_TIM1_Init();
  /* USER CODE BEGIN 2 */
	HAL_TIM_PWM_Start(&htim1,TIM_CHANNEL_1);
	
	tft_init();
	lcd_clear(WHITE);
//  LCD_ShowCharStr(0, HelloY, 80, "HELLOWORLD", GREEN , BLACK, 16);
//	draw_point(79,179,BLUE);
//	showimage(gImage_qq_logo,40,40);//显示

//	showgray(gImage_qq_logo,40,40);//灰度

//边缘检测
//graypic(gImage_qq_logo,gray);
//sobel_edge_detection(gray,edge);
//direct_show_gray(edge);

//颜色识别
color_detection(gImage_qq_logo);
	TIM1->PSC=0;
	TIM1->ARR=255;
	TIM1->CCR1=128;
 
//IIC实验
/*
HAL_I2C_Mem_Write()
HAL_I2C_Mem_Read()
*/

//    writedat=0x46;
//		HAL_I2C_Mem_Write(&hi2c1, ADDR_24LCxx_Write,16, I2C_MEMADD_SIZE_16BIT,&writedat,8, 1000);
//		HAL_Delay(20);
//		HAL_I2C_Mem_Read(&hi2c1, ADDR_24LCxx_Read, 0, I2C_MEMADD_SIZE_16BIT,&readdat,1, 1000);
//		printf("1:0x%2X\r\n",readdat);
//		HAL_Delay(20);
//		HAL_I2C_Mem_Read(&hi2c1, ADDR_24LCxx_Read, 16, I2C_MEMADD_SIZE_16BIT,&readdat,1, 1000);
//		printf("2:0x%2X\r\n",readdat);

  /* USER CODE END 2 */

  /* Infinite loop */
  /* USER CODE BEGIN WHILE */
//	uint32_t key_value1 = 0;
//	uint32_t key_value2 = 0;
//	uint32_t key_value3 = 0;
//	key_value1 = HAL_GPIO_ReadPin(GPIOA,GPIO_PIN_1);


  while (1)
  {
//		HAL_Delay(1000);
//		HAL_GPIO_WritePin(GPIOC,GPIO_PIN_13,GPIO_PIN_SET);
//		HAL_Delay(1000);
//		HAL_GPIO_WritePin(GPIOC,GPIO_PIN_13,GPIO_PIN_RESET);
//		printf("hello world\r\n");
	  			//消抖
		
//		HAL_Delay(20);
//		//读取按键电平状态
//		key_value2 = key_value1;
//		key_value1 = HAL_GPIO_ReadPin(GPIOA,GPIO_PIN_1);
////		HAL_Delay(10);
////		key_value3 = HAL_GPIO_ReadPin(GPIOA,GPIO_PIN_1);
//		if((key_value1 == 0)&&(key_value2==1))
//		{
//			HelloY+=16;
//			lcd_clear(WHITE);
//			LCD_ShowCharStr(0, HelloY, 80, "HELLOWORLD", BLUE , BLACK, 16);
//		}
//		if((key_value1 == 0)&&(key_value2==1)&&(key_value3==0))
//		{
//			HelloY-=16;
//			lcd_clear(WHITE);
//			LCD_ShowCharStr(0, HelloY, 80, "HELLOWORLD", BLUE , BLACK, 16);
//		}
		
//dac
//1k:2 2k:4 5k:10

//for(int i=0;i<3600;i+=4)
//{
//	TIM1->CCR1=sinwave[i];
//}
	TIM1->CCR1=128;
	TIM1->CNT=TIM1->CNT+65535-1;
	HAL_Delay(1);
    /* USER CODE END WHILE */

    /* USER CODE BEGIN 3 */
  }
  /* USER CODE END 3 */
}

/**
  * @brief System Clock Configuration
  * @retval None
  */
void SystemClock_Config(void)
{
  RCC_OscInitTypeDef RCC_OscInitStruct = {0};
  RCC_ClkInitTypeDef RCC_ClkInitStruct = {0};

  /** Initializes the RCC Oscillators according to the specified parameters
  * in the RCC_OscInitTypeDef structure.
  */
  RCC_OscInitStruct.OscillatorType = RCC_OSCILLATORTYPE_HSE;
  RCC_OscInitStruct.HSEState = RCC_HSE_ON;
  RCC_OscInitStruct.HSEPredivValue = RCC_HSE_PREDIV_DIV1;
  RCC_OscInitStruct.HSIState = RCC_HSI_ON;
  RCC_OscInitStruct.PLL.PLLState = RCC_PLL_ON;
  RCC_OscInitStruct.PLL.PLLSource = RCC_PLLSOURCE_HSE;
  RCC_OscInitStruct.PLL.PLLMUL = RCC_PLL_MUL9;
  if (HAL_RCC_OscConfig(&RCC_OscInitStruct) != HAL_OK)
  {
    Error_Handler();
  }

  /** Initializes the CPU, AHB and APB buses clocks
  */
  RCC_ClkInitStruct.ClockType = RCC_CLOCKTYPE_HCLK|RCC_CLOCKTYPE_SYSCLK
                              |RCC_CLOCKTYPE_PCLK1|RCC_CLOCKTYPE_PCLK2;
  RCC_ClkInitStruct.SYSCLKSource = RCC_SYSCLKSOURCE_PLLCLK;
  RCC_ClkInitStruct.AHBCLKDivider = RCC_SYSCLK_DIV1;
  RCC_ClkInitStruct.APB1CLKDivider = RCC_HCLK_DIV2;
  RCC_ClkInitStruct.APB2CLKDivider = RCC_HCLK_DIV1;

  if (HAL_RCC_ClockConfig(&RCC_ClkInitStruct, FLASH_LATENCY_2) != HAL_OK)
  {
    Error_Handler();
  }
}

/* USER CODE BEGIN 4 */

/* USER CODE END 4 */

/**
  * @brief  This function is executed in case of error occurrence.
  * @retval None
  */
void Error_Handler(void)
{
  /* USER CODE BEGIN Error_Handler_Debug */
  /* User can add his own implementation to report the HAL error return state */
  __disable_irq();
  while (1)
  {
  }
  /* USER CODE END Error_Handler_Debug */
}

#ifdef  USE_FULL_ASSERT
/**
  * @brief  Reports the name of the source file and the source line number
  *         where the assert_param error has occurred.
  * @param  file: pointer to the source file name
  * @param  line: assert_param error line source number
  * @retval None
  */
void assert_failed(uint8_t *file, uint32_t line)
{
  /* USER CODE BEGIN 6 */
  /* User can add his own implementation to report the file name and line number,
     ex: printf("Wrong parameters value: file %s on line %d\r\n", file, line) */
  /* USER CODE END 6 */
}
#endif /* USE_FULL_ASSERT */
