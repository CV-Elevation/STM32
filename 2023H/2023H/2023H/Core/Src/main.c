/* USER CODE BEGIN Header */
/**
  ******************************************************************************
  * @file           : main.c
  * @brief          : Main program body
  ******************************************************************************
  * @attention
  *
  * Copyright (c) 2023 STMicroelectronics.
  * All rights reserved.
  *
  * This software is licensed under terms that can be found in the LICENSE file
  * in the root directory of this software component.
  * If no LICENSE file comes with this software, it is provided AS-IS.
  *
  ******************************************************************************
  */
/* USER CODE END Header */
/* Includes ------------------------------------------------------------------*/
#include "main.h"
#include "adc.h"
#include "dac.h"
#include "dma.h"
#include "tim.h"
#include "usart.h"
#include "gpio.h"

/* Private includes ----------------------------------------------------------*/
/* USER CODE BEGIN Includes */

/* USER CODE END Includes */

/* Private typedef -----------------------------------------------------------*/
/* USER CODE BEGIN PTD */
ALIGN_32BYTES (uint16_t adc1_data[DFT_LENGTH]) 	__attribute__((section(".ARM.__at_0x30000000")));
__IO uint8_t AdcConvEnd = 0;//表示adc采集完成

uint8_t mode_flag = 0;			//0自校正，1手调节
uint8_t restart_flag = 0;		//重新分离

// 信号频率	索引
uint8_t fre[2];
// 信号种类	0正弦 1三角
uint8_t wave_type[2];
//	DAC输出数据
ALIGN_32BYTES (uint16_t data_A[200]) 	__attribute__((section(".ARM.__at_0x38000000")));
ALIGN_32BYTES (uint16_t data_B[200]) 	__attribute__((section(".ARM.__at_0x38004000")));
//	信号相差
double pos_angle_A;
double pos_angle_B;
//	延时
uint32_t delayT_A;
uint32_t delayT_B;
//	输入移相0-180
uint8_t change_pha = 0;
/* USER CODE END PTD */

/* Private define ------------------------------------------------------------*/
/* USER CODE BEGIN PD */

/* USER CODE END PD */

/* Private macro -------------------------------------------------------------*/
/* USER CODE BEGIN PM */

// 标准频率sin与cos表
uint16_t DAC_SIN[200 * 19] =
    // 第一行是20K -> 1s 10K
    { // DAC正弦缓冲区,每行 200点。第一行有2个正弦波，第三行有4个……第19行有20个
        2142, 2236, 2329, 2421, 2512, 2600, 2687, 2771, 2852, 2930, 3004, 3075,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 2048,
        2189, 2329, 2466, 2600, 2729, 2852, 2967, 3075, 3173, 3262, 3339, 3405,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 2048,
        2236, 2421, 2600, 2771, 2930, 3075, 3204, 3314, 3405, 3475, 3521, 3545,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 2048,
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        2930, 3475, 3475, 2930, 2048, 1166, 621, 621, 1166, 2048, 2930, 3475,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 1166, 2048};

uint16_t DAC_COS[200 * 19] =
    { // DAC余弦缓冲区,每行 200点。第一行有2个正弦波，第三行有4个……第19行有20个
        3545, 3536, 3521, 3501, 3475, 3443, 3405, 3362, 3314, 3262, 3204, 3141,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 3548,
        3541, 3521, 3488, 3443, 3385, 3314, 3233, 3141, 3040, 2930, 2812, 2687,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 3548,
        3536, 3501, 3443, 3362, 3262, 3141, 3004, 2852, 2687, 2512, 2329, 2142,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 3548,
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        3262, 2512, 1584, 834, 548, 834, 1584, 2512, 3262, 3548, 3262, 2512,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 3262, 3548};

uint16_t Tri_Wave[200 * 19] =
    {
        608, 668, 728, 788, 848, 908, 968, 1028, 1088, 1148, 1208, 1268,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 548,
        638, 728, 818, 908, 998, 1088, 1178, 1268, 1358, 1448, 1538, 1628,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 548,
        668, 788, 908, 1028, 1148, 1268, 1388, 1508, 1628, 1748, 1868, 1988,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 548,
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        1148, 1748, 2348, 2948, 3548, 2948, 2348, 1748, 1148, 548, 1148, 1748,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 1148, 548};


/* USER CODE END PM */

/* Private variables ---------------------------------------------------------*/

/* USER CODE BEGIN PV */

/* USER CODE END PV */

/* Private function prototypes -----------------------------------------------*/
void SystemClock_Config(void);
static void MPU_Initialize(void);
static void MPU_Config(void);
/* USER CODE BEGIN PFP */
void adc_init(void);
void cal_2fres(uint8_t *fre);
double power(double SC,double CC);
double dft_cal(uint16_t *T,uint16_t *Sin_Cos);
void cal_2types(uint8_t *fre,uint8_t *wave_type);
void get_pos_angle(void);


/* USER CODE END PFP */

/* Private user code ---------------------------------------------------------*/
/* USER CODE BEGIN 0 */

/* USER CODE END 0 */

/**
  * @brief  The application entry point.
  * @retval int
  */
int main(void)
{
  /* USER CODE BEGIN 1 */

  /* USER CODE END 1 */

  /* Enable I-Cache---------------------------------------------------------*/
  SCB_EnableICache();

  /* Enable D-Cache---------------------------------------------------------*/
  SCB_EnableDCache();

  /* MCU Configuration--------------------------------------------------------*/

  /* Reset of all peripherals, Initializes the Flash interface and the Systick. */
  HAL_Init();

  /* MPU Configuration--------------------------------------------------------*/
  MPU_Config();

  /* USER CODE BEGIN Init */

  /* USER CODE END Init */

  /* Configure the system clock */
  SystemClock_Config();

  /* USER CODE BEGIN SysInit */

  /* USER CODE END SysInit */

  /* Initialize all configured peripherals */
  MX_GPIO_Init();
  MX_DMA_Init();
  MX_TIM7_Init();
  MX_USART1_UART_Init();
  MX_ADC1_Init();
  MX_TIM15_Init();
  MX_DAC1_Init();
  MX_TIM4_Init();
  MX_TIM1_Init();
  /* USER CODE BEGIN 2 */
	printf("start\n");
  /* USER CODE END 2 */

  /* Infinite loop */
  /* USER CODE BEGIN WHILE */
  while (1)
  {
    /* USER CODE END WHILE */

    /* USER CODE BEGIN 3 */
restart:		
			wave_type[0] = 0;
			wave_type[1] = 0;
			adc_init();
			cal_2fres(fre);
			printf("freA=%d kHz\n",fre[0]*5+10);
			printf("freB=%d kHz\n",fre[1]*5+10);
			cal_2types(fre,wave_type);
			if(wave_type[0]==0)
			{
				printf("A:sin\n");
				for(uint8_t i=0;i<200;i++)
				data_A[i]=DAC_SIN[ fre[0]*200 + i ];
			}
			else
			{
				printf("A:tri\n");
				for(uint8_t i=0;i<200;i++)
				data_A[i]=Tri_Wave[ fre[0]*200 + i ];
			}
			
			if(wave_type[1]==0)
			{
				printf("B:sin\n");
				for(uint8_t i=0;i<200;i++)
				data_B[i]=DAC_SIN[ fre[1]*200 + i ];
			}
			else
			{
				printf("B:tri\n");
				for(uint8_t i=0;i<200;i++)
				data_B[i]=Tri_Wave[ fre[1]*200 + i ];
			}
			
//			HAL_DAC_Start_DMA(&hdac1,DAC_CHANNEL_1,(uint32_t *)data_A,200,DAC_ALIGN_12B_R);	//DMA
//			HAL_DAC_Start_DMA(&hdac1,DAC_CHANNEL_2,(uint32_t *)data_B,200,DAC_ALIGN_12B_R);
//			
			HAL_TIM_Base_Start(&htim1);//打开定时器1
			HAL_TIM_Base_Start(&htim4);//打开定时器4
			//不断调整相位
			while(1)
			{
				//相位自校正
				if(mode_flag == 0)
				{
					//A调相
					adc_init();
					get_pos_angle();
				  HAL_DAC_Stop_DMA(&hdac1,DAC_CHANNEL_1);	//DMA
					delayT_A = (24000.0 * pos_angle_A / (3.1415926 * ((double)fre[0]+2.0)) +0.5);
					TIM1->CNT = TIM1->CNT + 65535 - delayT_A;
				  HAL_DAC_Start_DMA(&hdac1,DAC_CHANNEL_1,(uint32_t *)data_A,200,DAC_ALIGN_12B_R);	//DMA

//					//B调相
					adc_init();
					get_pos_angle();
					delayT_B = (24000.0 * pos_angle_B / (3.1415926 * ((double)fre[1]+2.0)) +0.5);
					TIM4->CNT = TIM4->CNT + 65535 - delayT_B;
//						printf("delayT_A = %d\n",delayT_A);
//						printf("delayT_B = %d\n",delayT_B);
				}
				
				//相位可调节
				else
				{
					uint32_t tao = (double)change_pha / 360 /(fre[1] * 5.0 + 10) * 240000;
					
					//B调相
					adc_init();
					get_pos_angle();
					delayT_B = (24000.0 * pos_angle_B / (3.1415926 * ((double)fre[1]+2.0)) +0.5);
					TIM4->CNT = TIM4->CNT + 65535 - delayT_B;
					
					//A在B基础上延迟tao
					TIM1->CNT = TIM1->CNT + 65535 - delayT_A - tao;
					
				}
					if(restart_flag == 1)
					{
						restart_flag = 0;
						
						
						goto restart;
					}
			}
  }
  /* USER CODE END 3 */
}

/**
  * @brief System Clock Configuration
  * @retval None
  */
void SystemClock_Config(void)
{
  RCC_OscInitTypeDef RCC_OscInitStruct = {0};
  RCC_ClkInitTypeDef RCC_ClkInitStruct = {0};

  /** Supply configuration update enable
  */
  HAL_PWREx_ConfigSupply(PWR_LDO_SUPPLY);

  /** Configure the main internal regulator output voltage
  */
  __HAL_PWR_VOLTAGESCALING_CONFIG(PWR_REGULATOR_VOLTAGE_SCALE1);

  while(!__HAL_PWR_GET_FLAG(PWR_FLAG_VOSRDY)) {}

  __HAL_RCC_SYSCFG_CLK_ENABLE();
  __HAL_PWR_VOLTAGESCALING_CONFIG(PWR_REGULATOR_VOLTAGE_SCALE0);

  while(!__HAL_PWR_GET_FLAG(PWR_FLAG_VOSRDY)) {}

  /** Initializes the RCC Oscillators according to the specified parameters
  * in the RCC_OscInitTypeDef structure.
  */
  RCC_OscInitStruct.OscillatorType = RCC_OSCILLATORTYPE_HSE;
  RCC_OscInitStruct.HSEState = RCC_HSE_ON;
  RCC_OscInitStruct.PLL.PLLState = RCC_PLL_ON;
  RCC_OscInitStruct.PLL.PLLSource = RCC_PLLSOURCE_HSE;
  RCC_OscInitStruct.PLL.PLLM = 5;
  RCC_OscInitStruct.PLL.PLLN = 192;
  RCC_OscInitStruct.PLL.PLLP = 2;
  RCC_OscInitStruct.PLL.PLLQ = 2;
  RCC_OscInitStruct.PLL.PLLR = 2;
  RCC_OscInitStruct.PLL.PLLRGE = RCC_PLL1VCIRANGE_2;
  RCC_OscInitStruct.PLL.PLLVCOSEL = RCC_PLL1VCOWIDE;
  RCC_OscInitStruct.PLL.PLLFRACN = 0;
  if (HAL_RCC_OscConfig(&RCC_OscInitStruct) != HAL_OK)
  {
    Error_Handler();
  }

  /** Initializes the CPU, AHB and APB buses clocks
  */
  RCC_ClkInitStruct.ClockType = RCC_CLOCKTYPE_HCLK|RCC_CLOCKTYPE_SYSCLK
                              |RCC_CLOCKTYPE_PCLK1|RCC_CLOCKTYPE_PCLK2
                              |RCC_CLOCKTYPE_D3PCLK1|RCC_CLOCKTYPE_D1PCLK1;
  RCC_ClkInitStruct.SYSCLKSource = RCC_SYSCLKSOURCE_PLLCLK;
  RCC_ClkInitStruct.SYSCLKDivider = RCC_SYSCLK_DIV1;
  RCC_ClkInitStruct.AHBCLKDivider = RCC_HCLK_DIV2;
  RCC_ClkInitStruct.APB3CLKDivider = RCC_APB3_DIV2;
  RCC_ClkInitStruct.APB1CLKDivider = RCC_APB1_DIV2;
  RCC_ClkInitStruct.APB2CLKDivider = RCC_APB2_DIV2;
  RCC_ClkInitStruct.APB4CLKDivider = RCC_APB4_DIV2;

  if (HAL_RCC_ClockConfig(&RCC_ClkInitStruct, FLASH_LATENCY_4) != HAL_OK)
  {
    Error_Handler();
  }
}

/* USER CODE BEGIN 4 */

//dft运算中求∑
double dft_cal(uint16_t *T,uint16_t *Sin_Cos)
{
	uint16_t i;
	double result=0;
	for(i=0;i<1000;i++)
	{
		result = result + (T[i]-32768) * (Sin_Cos[i%200]-2048);
	}
	return result;
}
//求功率谱,实际求模长
double power(double SC,double CC)
{
	double power;
	power = sqrt(SC*SC+CC*CC);
	return power;
}
//信号主频率
void cal_2fres(uint8_t *fre)
{
	double SC=0;
	double CC=0;
	double Pow[19];				//功率谱
	double Pow_temp[19];	//存放排序后功率谱，最后根据索引给fre
	double temp;
	uint8_t i,j,i_temp;
	for(i=0;i<19;i++)
	{
		SC=dft_cal(adc1_data,DAC_SIN+200*i);		//第i行，200个一行
		CC=dft_cal(adc1_data,DAC_COS+200*i);
		Pow[i]=power(SC,CC);
		Pow_temp[i]=Pow[i];
	}
	//冒泡排序
	for(i=0;i<19-1;i++)
	{
		for(j=0;j<19-i-1;j++)
		{
			if(Pow_temp[j]<Pow_temp[j+1])	//降序
			{
				temp=Pow_temp[j];
				Pow_temp[j]=Pow_temp[j+1];
				Pow_temp[j+1]=temp;
			}
		}
	}
	//找最大值索引
	for(i=0;i<19;i++)
	{
		if(Pow[i]==Pow_temp[0])	//最大
			fre[0]=i;
		if(Pow[i]==Pow_temp[1])	//第二大
			fre[1]=i;
	}
	if(fre[0]>fre[1])	//低频放前面,fA<fB
	{
		i_temp=fre[0];
		fre[0]=fre[1];
		fre[1]=i_temp;
	}
}


//信号类型
void cal_2types(uint8_t *fre,uint8_t *wave_type)
{
	uint16_t fre_1_index,fre_3_index,fre_5_index;
	float temp_float;
	float pow_1,pow_3,pow_5;
	float k;
	_Bool conti;
	FFT_Init();		//FFT得到频谱，直接去找fre、3fre
	
	//信号一初步判断
	temp_float = (float) fre[0]*5+10;
	temp_float = temp_float/500;
	temp_float = temp_float*512;
	fre_1_index = temp_float+0.5;
	
	temp_float = (float) fre[0]*5+10;
	temp_float = temp_float/500;
	temp_float = temp_float*3*512;
	fre_3_index = temp_float+0.5;
	
	pow_1 = q1[fre_1_index-1].real + q1[fre_1_index].real + q1[fre_1_index+1].real;
	pow_3 = q1[fre_3_index-1].real + q1[fre_3_index].real + q1[fre_3_index+1].real;
	
	k = pow_1 / pow_3;
//	printf("k_A3= %f\n",k);
	if(k>250)
	{
		wave_type[0]=0;
	}
	else
	{
		wave_type[0]=1;
	}
	
	//信号二初步判断
	temp_float = (float) fre[1]*5+10;
	temp_float = temp_float/500;
	temp_float = temp_float*512;
	fre_1_index = temp_float+0.5;
	
	temp_float = (float) fre[1]*5+10;
	temp_float = temp_float/500;
	temp_float = temp_float*3*512;
	fre_3_index = temp_float+0.5;

	pow_1 = q1[fre_1_index-1].real + q1[fre_1_index].real + q1[fre_1_index+1].real;
	pow_3 = q1[fre_3_index-1].real + q1[fre_3_index].real + q1[fre_3_index+1].real;
	
	k = pow_1 / pow_3;
//	printf("k_B3= %f\n",k);
	if(k>250)
	{
		wave_type[1]=0;
	}
	else
	{
		wave_type[1]=1;
	}
	
	//特殊fB=3fA
	//对于B来说，他类型就有自身和三倍频判断，不会收A影响
	//对于A来说，A的三倍会被B污染，所以要根据五倍判断
	conti=((fre[0]==0)&&(fre[1]==4))||((fre[0]==1)&&(fre[1]==7))||((fre[0]==2)&&(fre[1]==10))||((fre[0]==3)&&(fre[1]==13))||((fre[0]==4)&&(fre[1]==16));
	if(conti)
	{
		temp_float = (float) fre[0]*5+10;
		temp_float = temp_float/500;
		temp_float = temp_float*512;
		fre_1_index = temp_float+0.5;
		
		temp_float = (float) fre[0]*5+10;
		temp_float = temp_float/500;
		temp_float = temp_float*512*5;
		fre_5_index = temp_float+0.5;
		
		pow_1 = q1[fre_1_index-1].real + q1[fre_1_index].real + q1[fre_1_index+1].real;
		pow_5 = q1[fre_5_index-1].real + q1[fre_5_index].real + q1[fre_5_index+1].real;
		
		k = pow_1 / pow_5;
		printf("k_A5= %f\n",k);
		if(k>500)		//根据实际调整
		{
			wave_type[1]=0;
			printf("A:sin \n");
		}
		else
		{
			wave_type[1]=1;
			printf("A:tri \n");
		}
	}
}
	
//求相位差
void get_pos_angle(void)
{
	double SC = dft_cal(adc1_data,DAC_SIN+200*fre[0]);
	double CC = dft_cal(adc1_data,DAC_COS+200*fre[0]);
	double phase = atan2(CC,SC);
	//phase在-pi到pi
	//<0，重建提前，延时即可
	//>0，重建延迟，再延时T-deltaT
	if(phase<0)
	{
		pos_angle_A = -phase;
	}
	else
	{
		pos_angle_A = 2*3.1415926 - phase;
	}
	SC = dft_cal(adc1_data,DAC_SIN+200*fre[1]);
	CC = dft_cal(adc1_data,DAC_COS+200*fre[1]);
	phase = atan2(CC,SC);
	if(phase<0)
	{
		pos_angle_B = -phase;
	}
	else
	{
		pos_angle_B = 2*3.1415926 - phase;
	}
//	printf("pos_angle_A = %f\n",pos_angle_A);
//	printf("pos_angle_B = %f\n",pos_angle_B);

}
//按键中断
void HAL_GPIO_EXTI_Callback(uint16_t GPIO_Pin)
{
	if(GPIO_Pin == KEY1_Pin)
	{
		restart_flag=1;
	}
}
//adc初始化
void adc_init(void)
{
//	printf("start_adc\n");
	MX_ADC1_Init();	//初始化调用放这里, 确保在MX_DMA_Init()初始化后靿  	
	HAL_Delay(100);	//有地方说这里可以等等电压稳定后再校准
	if (HAL_ADCEx_Calibration_Start(&hadc1, ADC_CALIB_OFFSET, ADC_SINGLE_ENDED) != HAL_OK)
	{
			printf("hadc1 error with HAL_ADCEx_Calibration_Start\r\n");
			Error_Handler();
	}

	if (HAL_ADC_Start_DMA(&hadc1, (uint32_t *)adc1_data, DFT_LENGTH) != HAL_OK)
	{
			printf("hadc1 error with HAL_ADC_Start_DMA\r\n");
			Error_Handler();
	}

	HAL_TIM_Base_Start(&htim15);
	while (!AdcConvEnd);
	AdcConvEnd = 0;
	HAL_ADC_DeInit(&hadc1);			//逆初始化
	HAL_TIM_Base_Stop(&htim15);
}
//ADC中断回调
void HAL_ADC_ConvCpltCallback(ADC_HandleTypeDef* hadc)
{
   if(hadc->Instance == ADC1) 
	{
      //SCB_InvalidateDCache_by_Addr((uint32_t *) &adc1_data[0], ADC1_BUFFER_SIZE);
		AdcConvEnd = 1;
  }
}





/* USER CODE END 4 */

/* MPU Configuration */

void MPU_Config(void)
{
  MPU_Region_InitTypeDef MPU_InitStruct = {0};

  /* Disables the MPU */
  HAL_MPU_Disable();

  /** Initializes and configures the Region and the memory to be protected
  */
  MPU_InitStruct.Enable = MPU_REGION_ENABLE;
  MPU_InitStruct.Number = MPU_REGION_NUMBER0;
  MPU_InitStruct.BaseAddress = 0x24000000;
  MPU_InitStruct.Size = MPU_REGION_SIZE_512KB;
  MPU_InitStruct.SubRegionDisable = 0x0;
  MPU_InitStruct.TypeExtField = MPU_TEX_LEVEL1;
  MPU_InitStruct.AccessPermission = MPU_REGION_FULL_ACCESS;
  MPU_InitStruct.DisableExec = MPU_INSTRUCTION_ACCESS_ENABLE;
  MPU_InitStruct.IsShareable = MPU_ACCESS_NOT_SHAREABLE;
  MPU_InitStruct.IsCacheable = MPU_ACCESS_CACHEABLE;
  MPU_InitStruct.IsBufferable = MPU_ACCESS_BUFFERABLE;

  HAL_MPU_ConfigRegion(&MPU_InitStruct);

  /** Initializes and configures the Region and the memory to be protected
  */
  MPU_InitStruct.Number = MPU_REGION_NUMBER1;
  MPU_InitStruct.BaseAddress = 0x30000000;
  MPU_InitStruct.Size = MPU_REGION_SIZE_128KB;
  MPU_InitStruct.IsCacheable = MPU_ACCESS_NOT_CACHEABLE;
  MPU_InitStruct.IsBufferable = MPU_ACCESS_NOT_BUFFERABLE;

  HAL_MPU_ConfigRegion(&MPU_InitStruct);

  /** Initializes and configures the Region and the memory to be protected
  */
  MPU_InitStruct.Number = MPU_REGION_NUMBER2;
  MPU_InitStruct.BaseAddress = 0x30020000;

  HAL_MPU_ConfigRegion(&MPU_InitStruct);

  /** Initializes and configures the Region and the memory to be protected
  */
  MPU_InitStruct.Number = MPU_REGION_NUMBER3;
  MPU_InitStruct.BaseAddress = 0x30040000;
  MPU_InitStruct.Size = MPU_REGION_SIZE_32KB;

  HAL_MPU_ConfigRegion(&MPU_InitStruct);

  /** Initializes and configures the Region and the memory to be protected
  */
  MPU_InitStruct.Number = MPU_REGION_NUMBER4;
  MPU_InitStruct.BaseAddress = 0x38000000;
  MPU_InitStruct.Size = MPU_REGION_SIZE_64KB;

  HAL_MPU_ConfigRegion(&MPU_InitStruct);
  /* Enables the MPU */
  HAL_MPU_Enable(MPU_PRIVILEGED_DEFAULT);

}

/**
  * @brief  This function is executed in case of error occurrence.
  * @retval None
  */
void Error_Handler(void)
{
  /* USER CODE BEGIN Error_Handler_Debug */
  /* User can add his own implementation to report the HAL error return state */
  __disable_irq();
  while (1)
  {
  }
  /* USER CODE END Error_Handler_Debug */
}

#ifdef  USE_FULL_ASSERT
/**
  * @brief  Reports the name of the source file and the source line number
  *         where the assert_param error has occurred.
  * @param  file: pointer to the source file name
  * @param  line: assert_param error line source number
  * @retval None
  */
void assert_failed(uint8_t *file, uint32_t line)
{
  /* USER CODE BEGIN 6 */
  /* User can add his own implementation to report the file name and line number,
     ex: printf("Wrong parameters value: file %s on line %d\r\n", file, line) */
  /* USER CODE END 6 */
}
#endif /* USE_FULL_ASSERT */
